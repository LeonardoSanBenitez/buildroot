## package/hello_driver/Config.in
```kconfig
config BR2_PACKAGE_HELLO_DRIVER
bool "hello_driver"
help
This is sample package.
```

## package/sensor_bh1750/Config.in
```kconfig
config BR2_PACKAGE_SENSOR_BH1750
	bool "sensor_bh1750"
	help
	This is sample package.
		Driver to read the light sensor BH1750
```
